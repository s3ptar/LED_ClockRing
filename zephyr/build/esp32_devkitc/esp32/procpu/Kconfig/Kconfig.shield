## zephyr/build/esp32c3_devkitc/Kconfig/boards/Kconfig.defconfig
```kconfig
# Load Zephyr board defconfig descriptions.
osource "D:/zephyr/external/zephyr/boards/espressif/esp32c3_devkitc/Kconfig.defconfig"
```

## zephyr/build/esp32c3_devkitc/Kconfig/boards/Kconfig.sysbuild
```kconfig
# Load Sysbuild board Kconfig descriptions.
osource "D:/zephyr/external/zephyr/boards/espressif/esp32c3_devkitc/Kconfig.sysbuild"
```
